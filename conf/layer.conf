## conf/layer.conf
```bitbake
# We have a conf and classes directory, append to BBPATH
BBPATH .= ":${LAYERDIR}"

# We have a recipes directory, add to BBFILES
BBFILES += "${LAYERDIR}/recipes-*/*/*.bb \
            ${LAYERDIR}/recipes-*/*/*.bbappend"

BBFILE_COLLECTIONS += "wpi-fastboot"
BBFILE_PATTERN_wpi-fastboot := "^${LAYERDIR}/"
BBFILE_PRIORITY_wpi-fastboot = "9"

LAYERDEPENDS_wpi-fastboot = "core"
LAYERSERIES_COMPAT_wpi-fastboot = "scarthgap"
```

## conf/machine/opgyro-fastboot.conf
```bitbake
#@TYPE: Machine
#@NAME: i.MX 93 11x11 EVK Falcon Mode
#@DESCRIPTION: i.MX 93 11x11 Evaluation Kit Falcon Mode configuration
#@MAINTAINER: Elena Popa <elena.popa@nxp.com>

require conf/machine/opgyro.conf

UBOOT_CONFIG_BASENAME = "op_gyro_falcon"

IMAGE_BOOT_FILES:append = " \
    u-boot-atf-container.img \
    kernel-atf-container.img \
"
```
